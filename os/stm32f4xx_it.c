/******************************************************************************
 *
 * 文件名  ： stm32f4xx_it.c
 * 负责人  ： 彭鹏(pengpeng@fiberhome.com)
 * 创建日期： 20150321 
 * 版本号  ： v1.0
 * 文件描述： 中断服务(ISR)定义
 * 版权说明： Copyright (c) 2000-2020 GNU
 * 其    他： 所有新增ISR都在该文件中定义
 *            函数名需要与startup_<device_name>.s保持一致,定义格式如下：
 *            void ISR_NAME_IRQHandler(void)
 *            {
 *            }
 *
 * 修改日志： 无
 *
 *******************************************************************************/
/*---------------------------------- 预处理区 ---------------------------------*/

/************************************ 头文件 ***********************************/
#include "cmsis_os.h"

#include "typedef_tm.h"

#include "stm32f4xx_hal_conf.h"
#include "stm32f4xx_it.h"

/*----------------------------------- 声明区 ----------------------------------*/

/********************************** 变量声明区 *********************************/
/********************************************************************************
 *
 * 变量功能: 系统的时钟值 每次进入SysTick中断自己加一次
 * 取值范围: 0 - 0xFFFFFFFF
 * 注意事项: 无
 *
 *******************************************************************************/
uint32_t g_tick = 0;

/********************************** 函数声明区 *********************************/


/********************************** 变量实现区 *********************************/


/********************************** 函数实现区 *********************************/
/*******************************************************************************
 *
 * 函数名  : NMI_Handler
 * 负责人  : 彭鹏
 * 创建日期：20150321 
 * 函数功能: NMI ISR
 *
 * 输入参数: 无
 *
 * 输出参数: 无
 *
 * 返回值  : 无
 *          
 * 调用关系: 无
 * 其 它   : 无
 *
 ******************************************************************************/
void NMI_Handler(void)
{
}

/*******************************************************************************
 *
 * 函数名  : HardFault_Handler
 * 负责人  : 彭鹏
 * 创建日期：20150321 
 * 函数功能: HardFault ISR
 *
 * 输入参数: 无
 *
 * 输出参数: 无
 *
 * 返回值  : 无
 *          
 * 调用关系: 无
 * 其 它   : 无
 *
 ******************************************************************************/
void HardFault_Handler(void)
{
  while (1)
  {
		;
  }
}

/*******************************************************************************
 *
 * 函数名  : MemManage_Handler
 * 负责人  : 彭鹏
 * 创建日期：20150321 
 * 函数功能: MemManage ISR
 *
 * 输入参数: 无
 *
 * 输出参数: 无
 *
 * 返回值  : 无
 *          
 * 调用关系: 无
 * 其 它   : 无
 *
 ******************************************************************************/
void MemManage_Handler(void)
{
  while (1)
  {
  }
}

/*******************************************************************************
 *
 * 函数名  : BusFault_Handler
 * 负责人  : 彭鹏
 * 创建日期：20150321 
 * 函数功能: BusFault ISR
 *
 * 输入参数: 无
 *
 * 输出参数: 无
 *
 * 返回值  : 无
 *          
 * 调用关系: 无
 * 其 它   : 无
 *
 ******************************************************************************/
void BusFault_Handler(void)
{
  while (1)
  {
  }
}

/*******************************************************************************
 *
 * 函数名  : UsageFault_Handler
 * 负责人  : 彭鹏
 * 创建日期：20150321 
 * 函数功能: UsageFault ISR
 *
 * 输入参数: 无
 *
 * 输出参数: 无
 *
 * 返回值  : 无
 *          
 * 调用关系: 无
 * 其 它   : 无
 *
 ******************************************************************************/
void UsageFault_Handler(void)
{
  while (1)
  {
  }
}

/*******************************************************************************
 *
 * 函数名  : SVC_Handler
 * 负责人  : 彭鹏
 * 创建日期：20150321 
 * 函数功能: SVC ISR
 *
 * 输入参数: 无
 *
 * 输出参数: 无
 *
 * 返回值  : 无
 *          
 * 调用关系: 无
 * 其 它   : 无
 *
 ******************************************************************************/
__asm void SVC_Handler(void)
{
    IMPORT SVC_Handler_C
    /* 8字节对齐 */
    REQUIRE8
    PRESERVE8 

    TST   LR, #4 /* 测试EXC_RETURN的bit2 用于检查当前SP为 PSP or MSP */
    ITE   EQ
    MRSEQ R0, MSP /* 为0则使用MSP */
    MRSNE R0, PSP /* 为1则使用MSP */
    B     SVC_Handler_C /* 调用C语言主逻辑 */
}

/*******************************************************************************
 *
 * 函数名  : DebugMon_Handler
 * 负责人  : 彭鹏
 * 创建日期：20150321 
 * 函数功能: DebugMon ISR
 *
 * 输入参数: 无
 *
 * 输出参数: 无
 *
 * 返回值  : 无
 *          
 * 调用关系: 无
 * 其 它   : 无
 *
 ******************************************************************************/
void DebugMon_Handler(void)
{

}

/*******************************************************************************
 *
 * 函数名  : SwitchSP
 * 负责人  : 彭鹏
 * 创建日期：20150331 
 * 函数功能: 不停的切换两个任务 010101......
 *
 * 输入参数: 当前任务sp
 *
 * 输出参数: 无
 *
 * 返回值  : 准备运行任务的sp
 *          
 * 调用关系: 无
 * 其 它   : 无
 *
 ******************************************************************************/
void *SwitchSP(const void *cur_stack)
{
    extern osThreadCb_t g_thread_cb[2];
    static int32 next_id = 0;
    uint32 *next_psp = NULL; 
    
    next_id++;
    next_id %=2; 
    
    next_psp = g_thread_cb[next_id].psp; 
    return next_psp;
}

/*******************************************************************************
 *
 * 函数名  : PendSV_Handler
 * 负责人  : 彭鹏
 * 创建日期：20150321 
 * 函数功能: PendSV_Handler ISR 用于任务切换
 *
 * 输入参数: 无
 *
 * 输出参数: 无
 *
 * 返回值  : 无
 *          
 * 调用关系: 无
 * 其 它   : 
 *           任务栈结构:
 *           xPSR
 *           PC
 *           LR
 *           R12
 *           R3
 *           R2
 *           R1
 *           R0             以上硬件负责入栈
 *           ---------------------------------
 *           LR(EXC_RETURN) 以下软件负责入栈
 *           R11
 *           R10
 *           R9
 *           R8
 *           R7
 *           R6
 *           R5
 *           R4             新PS指向
 *  
 *
 *           任务切换: 
 *              1. 把 R4-R11 LR(EXC_RETURN)压入PSP栈中, 保护寄存器原来的内容.
 *              2. 更新当前的PSP栈指针为任务调度算法函数返回的栈指针.
 *              3. 利用新的PSP栈指针, 从PSP栈中恢复 R4-R11 LR(EXC_RETURN)的内容.
 *              4. 利用 bx lr 指令进行中断返回, 实现任务切换.
 *              返回地址保存在栈中,而我们把栈指针指向了另一个任务的栈,
 *              所以中断函数的返回地址就被我们偷偷地修改了
 * 
 ******************************************************************************/
__asm void PendSV_Handler(void)
{
    /* 导入调度算法 */
    IMPORT SwitchSP

    /* 8字节对齐 */
    REQUIRE8
    PRESERVE8 
    
    /* step 1 */ 
    MRS R0 , PSP
    STMDB.W R0!, {R4-R11,LR} /* 等效于PUSH {R4-R11, LR} */
    /* r0此时已经是最新的psp值 */
    
    /* step 2 r0作为参数和返回值 */
    BL SwitchSP
    /* r0此时已经是最新的psp值 */
   
    /* step 3 */
    LDMIA.W R0!, {R4-R11,LR} /* 等效于 POP {R4-R11, LR} */
    MSR PSP, R0
    ISB
    
    /* step 4 */
    BX LR

    ALIGN 4
}


/*******************************************************************************
 *
 * 函数名  : SysTick_Handler
 * 负责人  : 彭鹏
 * 创建日期：20150321 
 * 函数功能: SysTick ISR
 *
 * 输入参数: 无
 *
 * 输出参数: 无
 *
 * 返回值  : 无
 *          
 * 调用关系: 无
 * 其 它   : 无
 *
 ******************************************************************************/
void SysTick_Handler(void)
{
    g_tick++;
    /* 悬起PendSV异常(此时必然为咬尾中断) 准备任务切换 */
    SCB->ICSR |= SCB_ICSR_PENDSVSET_Msk;
}

