/******************************************************************************
 *
 * 文件名  ： device.c
 * 负责人  ： 彭鹏(pengpeng@fiberhome.com)
 * 创建日期： 20151030
 * 版本号  ： v1.0
 * 文件描述： 硬件设备树的实现
 * 版权说明： Copyright (c) 2000-2020 GNU
 * 其    他： 无
 *
 * 修改日志： 无
 *
 *******************************************************************************/
/*---------------------------------- 预处理区 ---------------------------------*/

/************************************ 头文件 ***********************************/
#include "cmos_config.h"
#include "vfs.h"
#include "device.h"
#include "console.h"

/*----------------------------------- 声明区 ----------------------------------*/

/********************************** 变量声明区 *********************************/

/********************************** 函数声明区 *********************************/

/********************************** 变量实现区 *********************************/

/********************************** 函数实现区 *********************************/
/*******************************************************************************
*
* 函数名  : hal_device_add
* 负责人  : 彭鹏
* 创建日期: 20151104
* 函数功能: cmos vfs中加入设备并绑定驱动
*
* 输入参数: name   vfs设备名字
*           driver 驱动指针
*
* 输出参数: 无
*
* 返回值  : 函数执行状态
*
* 调用关系: 无
* 其 它   : TODO:del中需要对应的内存释放
*
******************************************************************************/
cmos_status_T hal_device_add(const cmos_uint8_T *name, const void *driver)
{
    if((NULL == name)
    || (NULL == driver))
    {
        CMOS_ERR_STR("hal_device_del name or driver is null.");
        return cmos_NULL_E;
    }

    cmos_status_T status = cmos_ERR_E; 

    /* 加入设备结点*/
    status = vfs_node_add(CMOS_VFS_DEV_DIR, name, vfs_dev, driver);
    if(cmos_OK_E != status)
    {
        return status;
    }

    status = cmos_OK_E;
    return status;
}

/*******************************************************************************
*
* 函数名  : hal_device_del
* 负责人  : 彭鹏
* 创建日期: 20151104
* 函数功能: cmos vfs中删除设备并解除绑定
*
* 输入参数: name   vfs设备名字
*
* 输出参数: 无
*
* 返回值  : 函数执行状态
*
* 调用关系: 无
* 其 它   : 释放内存
*
******************************************************************************/
cmos_status_T hal_device_del(const cmos_uint8_T *name)
{
    if(NULL == name)
    {
        CMOS_ERR_STR("hal_device_del name or driver is null.");
        return cmos_NULL_E;
    }

    cmos_status_T status = cmos_ERR_E; 

    status = cmos_OK_E;
    return status;
}

